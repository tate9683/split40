## boards/shields/split40/Kconfig.defconfig
```kconfig
if SHIELD_SPLIT40_L

config ZMK_KEYBOARD_NAME
    default "Split40"

config ZMK_BLE
    default y

config ZMK_SPLIT_ROLE_CENTRAL
    default y

endif

if SHIELD_SPLIT40_L || SHIELD_SPLIT40_R

config ZMK_SPLIT
    default y

endif
```
